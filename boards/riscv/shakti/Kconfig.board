## boards/riscv/shakti/Kconfig.board
```kconfig
config BOARD_SHAKTI
    bool "Shakti Eval Board"
    depends on SOC_RISCV32_SHAKTI
```

## dts/bindings/serial/shakti,uart0.yaml
```yaml
#
# Copyright (c) 2018, SiFive Inc.
#
# SPDX-License-Identifier: Apache-2.0
#
---
title: SHAKTI UART
version: 0.1

description: >
  This binding gives a base representation of the shakti UART

include:
  uart-controller.yaml

properties:
  compatible: "shakti,uart0"


  reg:
    type: array
    description: mmio register space
    generation: define
    category: required

  interrupts:
    type: array
    category: required
    description: required interrupts
    generation: define

...
```

## soc/riscv/shakti/Kconfig.defconfig
```kconfig
# Copyright (c) 2018 - 2019 Antmicro <www.antmicro.com>
# SPDX-License-Identifier: Apache-2.0

if SOC_RISCV32_SHAKTI

config SOC
	default "shakti"

config SYS_CLOCK_HW_CYCLES_PER_SEC
	int
	default 32768

config RISCV_SOC_INTERRUPT_INIT
	bool
	default y

config RISCV_HAS_CPU_IDLE
	bool
	default y

config NUM_IRQS
	int
	default 64

config RISCV_RAM_BASE_ADDR
	hex
	default	0x80000000

config RISCV_RAM_SIZE
	hex
	default 0x8000


endif # SOC_RISCV32_SHAKTI
```

## soc/riscv/shakti/Kconfig.soc
```kconfig
# Copyright (c) 2018 - 2019 Antmicro <www.antmicro.com>
# SPDX-License-Identifier: Apache-2.0

config SOC_RISCV32_SHAKTI
	bool "SHAKTI SoC implementation"
	select RISCV
	select ATOMIC_OPERATIONS_C
	select INCLUDE_RESET_VECTOR
	select RISCV_ISA_RV32I
	select RISCV_ISA_EXT_M
	select RISCV_ISA_EXT_A
	select RISCV_ISA_EXT_ZICSR
	select RISCV_ISA_EXT_ZIFENCEI
```
